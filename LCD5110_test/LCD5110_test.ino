// copy, https://www.e-tinkers.com/2017/11/how-to-use-lcd-5110-pcd-8544-with-arduino/
// 2019-FEB-07, xiaolaba, test ok.
// Arduino IDE 1.8.2
// Arduino UNO used 

#include <SPI.h>;
// Mapping LCD module signals with Arduino pins
// hardware SPI interface used, SCLK & DN must be the pins, not anything else,
// NOKIA 5110 LCD module (red PCB), 8-pin sequency as following,

#define use_define
//#define use_const

#if defined use_define
// hardware setup
#define LED  6    // pin#8, any pin ok, BACKLIGHT+
#define SCLK 13   // SPI CLK, SCLK Must connect to Arduino D13 (SPI CLK) when using SPI library
#define DN   11   // SPI DATA, Must connect to Arduino D11 (SPI MOSI) when using SPI library
#define DC   10   // any pin ok, Data/Command or Register Select (RS)
#define RST  9    // any pin ok, RESET
#define SCE  8    // any pin ok, Select Chip Enable
#define GND  0V   // dummy, no actial uses of code
#define VCC  +3V3 // pin#1, dummy, no actial uses of code

// software setup
#define LCD_WIDTH  84
#define LCD_HEIGHT 48
#define LCD_CMD    LOW  // DC pin = 0
#define LCD_DATA   HIGH // DC pin = 1
#define LED_ON     HIGH // backlight LED pin = 3V
#define LED_OFF    LOW  // backlight LED pin = 0V
#endif


#if defined use_const
// hardware setup
const int LED = 6;
const int SCLK = 13; // Must connect to Arduino D13 (SPI SCLK) when using SPI library
const int DN = 11; // Must connect to Arduino D11 (SPI MOSI) when using SPI library
const int DC = 10;
const int RST = 9;
const int SCE = 8;

// software setup
const int LCD_WIDTH = 84;
const int LCD_HEIGHT = 48;
const int LCD_CMD = LOW;
const int LCD_DATA = HIGH;
const int LED_ON = HIGH;
const int LED_OFF = LOW;
#endif


boolean _inverse = false;
 
unsigned char eTinkersLogo[LCD_HEIGHT * LCD_WIDTH / 8 + 1] = {
0x00, 0x00, 0x00, 0x00, 0x00, 0x00, 0x00, 0x00, 0xe0, 0xf0, 0xf0, 0xf8,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 0x00,
0x00, 0x00, 0x00, 0x00, 0x00, 0x00, 0x00, 0x00, 0xff, 0xff, 0xff, 0xff,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 0x00,
0x00, 0x00, 0x00, 0x00, 0x00, 0x00, 0x00, 0x00, 0xff, 0xff, 0xff, 0xff,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 0x00,
0x00, 0x00, 0x00, 0x00, 0x00, 0x00, 0x00, 0x00, 0xff, 0xff, 0xff, 0xff,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 0x00,
0xf0, 0xf8, 0xf8, 0xf8, 0xf8, 0xf8, 0xf8, 0xf8, 0xff, 0xff, 0xff, 0xff,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 0xf0,
0x00, 0x01, 0x07, 0x0f, 0x0f, 0x1f, 0x1f, 0x1f, 0x1f, 0x1f, 0x1f, 0x1f,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 0x00
};
 
void printStr(unsigned char str[]) {
  unsigned int p, i;
  unsigned char b;
  const unsigned char FONT_TABLE [][5] = {
  { 0x00, 0x00, 0x00, 0x00, 0x00 }, // 0x20, space
  { 0x00, 0x00, 0x5f, 0x00, 0x00 }, // 0x21, !
  { 0x00, 0x07, 0x00, 0x07, 0x00 }, // 0x22, "
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  { 0x78, 0x46, 0x41, 0x46, 0x78 } // 0x7f, DEL
  };

  p = 0;
  while (str[p]!='\0') {
    if ( (str[p] >= 0x20) & (str[p] <= 0x7f) ) {
      for (i = 0; i < 5; i++) {
      b = FONT_TABLE[str[p] - 32][i];
      write(LCD_DATA, b);
      }
      write(LCD_DATA, 0x00);
    }
    p++;
  }
}
 
void printImage(unsigned char image[]) {
  unsigned int i;
  cursor(1,1);
  for (i = 0; i < (LCD_WIDTH * LCD_HEIGHT / 8); i++) {
    write(LCD_DATA, image[i]);
  }
}
 
void inverse(boolean inv) {
  _inverse = inv;
}
 
void backlight(boolean state) {
  digitalWrite(LED, state);
}
 
void cursor(unsigned char row, unsigned char col) {
  if ( (row < 1 | row > LCD_HEIGHT / 8) | (col < 1 | col > LCD_WIDTH / 6)) {
    return;
  }
  write(LCD_CMD, 0x40 | ( row - 1) );
  write(LCD_CMD, 0x80 | ( col - 1)*6 );
}
 
void clear(void) {
  int pixel;
  cursor(0,0);
  for (pixel=(LCD_WIDTH * LCD_HEIGHT / 8); pixel > 0; pixel--) {
    write(LCD_DATA, 0x00);
  }
}
 
void write(unsigned int mode, unsigned char data) {
  digitalWrite(SCE, LOW);
  digitalWrite(DC, mode); //HIGH = Data mode, LOW = Command mode
  if (mode == HIGH & _inverse == true) {
    data = ~ data;
  }
  SPI.transfer(data);
  digitalWrite(SCE, HIGH);
}
 
void setup() {
  pinMode(SCLK, OUTPUT);
  pinMode(DN, OUTPUT);
  pinMode(DC, OUTPUT);
  pinMode(SCE, OUTPUT);
  pinMode(RST, OUTPUT);
  pinMode(LED, OUTPUT);
   
  SPI.begin();
  SPI.setDataMode(SPI_MODE0);
  SPI.setBitOrder(MSBFIRST);
 
  digitalWrite(RST, HIGH);
  digitalWrite(SCE, HIGH);
  write(LCD_CMD, 0x21); // Set Extended Command set
  write(LCD_CMD, 0xb2); // Set Vlcd to 6v (LCD Contrast)
  write(LCD_CMD, 0x13); // Set voltage bias system 1:48 (Viewing Angle)
  write(LCD_CMD, 0x20); // Set Normal Command set
  clear(); // Clear all display memory and set cursor to 1,1
  write(LCD_CMD, 0x09); // Set all pixels ON
  write(LCD_CMD, 0x0c); // Set display mode to Normal
   
  backlight(LED_OFF);
}
 
void loop(){
  cursor(0, 1);
  printStr("xiaolaba test");
  cursor(2, 1);
  printStr(" Hello World! ");
  cursor(4, 2);
  printStr("e-tinkers.com");
  inverse(true);
  cursor(6,1);
  printStr("** Nov 2017 **");
  inverse(false);
  delay(5000);
 
  backlight(LED_ON);
  printImage(eTinkersLogo);
  delay(5000);
  backlight(LED_OFF);
  clear();
}
